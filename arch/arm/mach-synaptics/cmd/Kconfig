## arch/arm/mach-synaptics/cmd/Kconfig
```kconfig
menu "Synaptics specific command line interface"

config CMD_SYNA_EMMCBOOT
	bool "Enable boot Linux from eMMC"
	depends on SYNA_SUBOOT

config CMD_SYNA_FDT_UPDATE
	bool "Enable FDT update before booting Kernel"
	depends on SYNA_SUBOOT

config CMD_SYNA_USBLOAD
	bool "Enable loading image from USB slave"
	depends on SYNA_USB_UBOOT
endmenu
```

## arch/arm/mach-synaptics/drivers/Kconfig
```kconfig
menu "Synaptics drivers support"
source "arch/arm/mach-synaptics/drivers/plat/Kconfig"
source "arch/arm/mach-synaptics/drivers/mmc/Kconfig"
source "arch/arm/mach-synaptics/drivers/net/Kconfig"
source "arch/arm/mach-synaptics/drivers/usb/Kconfig"
source "arch/arm/mach-synaptics/drivers/pinctrl/Kconfig"
source "arch/arm/mach-synaptics/drivers/pmic/Kconfig"
source "arch/arm/mach-synaptics/drivers/reset/Kconfig"
source "arch/arm/mach-synaptics/drivers/spi/Kconfig"
source "arch/arm/mach-synaptics/drivers/clk/Kconfig"
endmenu
```

## arch/arm/mach-synaptics/drivers/plat/Kconfig
```kconfig
config SYNA_BM
	bool "Enable BM call"
	depends on CMD_SYNA_USBLOAD
	default y

config SYNA_TZ_MR
        bool "Use memory layout from TZ"
        depends on SYNA_SUBOOT

config SYNA_TA
	bool "Load Synaptics TA"
	depends on SYNA_TZ_MR
	default n

config SYNA_TA_CYPT
	bool "Load Synaptics Crypto TA"
	depends on SYNA_TA
	default n

config SYNA_TA_LOGO
	bool "Load Synaptics Logo TA"
	depends on SYNA_TA
	default n

config SYNA_TEE
	bool "Enable Synaptics TEE APIs"
	depends on SYNA_SUBOOT
	default y

config SYNA_SM
	bool "Support System Manager Start in U-Boot"
	depends on SYNA_SUBOOT

config SYNA_INCLUDE_SM_FW
	bool "Build System Manager firmware into U-Boot"
	depends on SYNA_SM
```
